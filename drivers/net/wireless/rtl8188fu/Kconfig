## drivers/net/wireless/rtl8188fu/Kconfig
```kconfig
# SPDX-License-Identifier: GPL-2.0
config RTL8188FU
	tristate "Realtek 8188F USB WiFi"
	depends on USB && CFG80211
	---help---
	  Realtek vendor driver v4.3.23.6_20964.20170110, from
	  https://github.com/kelebek333/rtl8188fu (commit 17825f9).
```

## drivers/net/wireless/rtl8192eu/Kconfig
```kconfig
config RTL8192EU
	tristate "Realtek 8192E USB WiFi"
	depends on USB && CFG80211
	---help---
	  Realtek vendor driver v4.4.1_17696.20160509_BTCOEX20160412-0042, from
	  https://github.com/Mange/rtl8192eu-linux-driver (commit e7361e9).
```

## drivers/net/wireless/rtl8812au/Kconfig
```kconfig
config RTL8812AU
	tristate "Realtek 8812A USB WiFi"
	depends on USB && CFG80211
	---help---
	  Realtek vendor driver v4.3.20_16317.20160108, from
	  https://github.com/diederikdehaas/rtl8812AU (commit ff7a171).
```
